## drivers/sensor/sdp8xx/Kconfig
```kconfig
# Copyright (c) 2025 Lauri Pöhö
# SPDX-License-Identifier: Apache-2.0

config SDP8XX
    bool "SDP8xx Differential Pressure Sensor"
    default y
    depends on DT_HAS_SENSIRION_SDP8XX_ENABLED
    select I2C
    select CRC
    help
      Enable driver for Sensirion SDP8xx Differential Pressure Sensor.
```

## dts/bindings/sensor/sensirion,sdp8xx.yaml
```yaml
description: Sensirion SDP8XX Differential Pressure Sensor

compatible: "sensirion,sdp8xx"

include: [sensor-device.yaml, i2c-device.yaml]

properties:
  clock-stretching:
    type: boolean
    description: |
      If set, uses I2C clock stretching (sensor holds SCL low).
      If unset, uses polling (repeated read attempts).
  averaging:
    type: boolean
    description: |
      If set, averages continuous mode measurements..
  measurement-mode:
    type: string
    default: "mass-flow"
    description: "Initial measurement mode at boot"
    enum:
      - "diff-pressure"
      - "mass-flow"
```
